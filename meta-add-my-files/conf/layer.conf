## meta-add-my-files/conf/layer.conf
```bitbake
# We have a conf and classes directory, add to BBPATH
BBPATH .= ":${LAYERDIR}"

# We have recipes-* directories, add to BBFILES
BBFILES += "${LAYERDIR}/recipes-*/*/*.bb \
            ${LAYERDIR}/recipes-*/*/*.bbappend"

BBFILE_COLLECTIONS += "meta-add-my-files"
BBFILE_PATTERN_meta-add-my-files = "^${LAYERDIR}/"
BBFILE_PRIORITY_meta-add-my-files = "6"

LAYERDEPENDS_meta-add-my-files = "core"
LAYERSERIES_COMPAT_meta-add-my-files = "kirkstone"
```

## meta-run-script-at-boot/conf/layer.conf
```bitbake
# We have a conf and classes directory, add to BBPATH
BBPATH .= ":${LAYERDIR}"

# We have recipes-* directories, add to BBFILES
BBFILES += "${LAYERDIR}/recipes-*/*/*.bb \
            ${LAYERDIR}/recipes-*/*/*.bbappend"

BBFILE_COLLECTIONS += "meta-run-script-at-boot"
BBFILE_PATTERN_meta-run-script-at-boot = "^${LAYERDIR}/"
BBFILE_PRIORITY_meta-run-script-at-boot = "6"

LAYERDEPENDS_meta-run-script-at-boot = "core"
LAYERSERIES_COMPAT_meta-run-script-at-boot = "kirkstone"
```

## poky_kirkstone/build/conf/bblayers.conf
```bitbake
# POKY_BBLAYERS_CONF_VERSION is increased each time build/conf/bblayers.conf
# changes incompatibly
POKY_BBLAYERS_CONF_VERSION = "2"

BBPATH = "${TOPDIR}"
BBFILES ?= ""

BBLAYERS ?= " \
  /home/petecosh/Escritorio/Yocto_Kirkstone/poky/meta \
  /home/petecosh/Escritorio/Yocto_Kirkstone/poky/meta-poky \
  /home/petecosh/Escritorio/Yocto_Kirkstone/poky/meta-yocto-bsp \
  /home/petecosh/Escritorio/Yocto_Kirkstone/poky/meta-add-my-files \
  /home/petecosh/Escritorio/Yocto_Kirkstone/poky/meta-tegra \
  /home/petecosh/Escritorio/Yocto_Kirkstone/poky/meta-openembedded/meta-oe \
  /home/petecosh/Escritorio/Yocto_Kirkstone/poky/meta-openembedded/meta-python \
  /home/petecosh/Escritorio/Yocto_Kirkstone/poky/meta-openembedded/meta-networking \
  /home/petecosh/Escritorio/Yocto_Kirkstone/poky/meta-openembedded/meta-multimedia \
  /home/petecosh/Escritorio/Yocto_Kirkstone/poky/meta-openembedded/meta-gnome \
  /home/petecosh/Escritorio/Yocto_Kirkstone/poky/meta-openembedded/meta-xfce \
  /home/petecosh/Escritorio/Yocto_Kirkstone/poky/meta-run-script-at-boot \
  "
```
